/*
 * Copyright (c) 2020 The ZMK Contributors
 *
 * SPDX-License-Identifier: MIT
 */

#include "dumbpad.dtsi"

/ {
    chosen {
        zmk,kscan = &kscan0;
    };

    kscan0: kscan {
        compatible = "zmk,kscan-gpio-matrix";
        wakeup-source;

        diode-direction = "col2row";
        
        row-gpios =

            <&pro_micro 17 (GPIO_ACTIVE_HIGH)>, 
            <&pro_micro 16 (GPIO_ACTIVE_HIGH)>, 
            <&pro_micro 15 (GPIO_ACTIVE_HIGH)>, 
            <&pro_micro 14 (GPIO_ACTIVE_HIGH)>;

        };
    };

&left_encoder {
    status = "okay";
}; 
